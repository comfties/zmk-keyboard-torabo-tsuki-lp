#include "torabo_tsuki_lp.dtsi"
#include <input/processors.dtsi>
#include <dt-bindings/zmk/input_transform.h>

/ {
    zip_xy_scaler_snipe: zip_xy_scaler_snipe {
        compatible = "zmk,input-processor-scaler";
        #input-processor-cells = <2>;
    };
};

&pointing_listener {
    input-processors = <&zip_xy_transform (INPUT_TRANSFORM_X_INVERT | INPUT_TRANSFORM_Y_INVERT)>, <&zip_temp_layer_custom 4 1000>;

    snipe_mode {
        layers = <5>;
        input-processors = <&zip_xy_transform (INPUT_TRANSFORM_X_INVERT | INPUT_TRANSFORM_Y_INVERT)>, <&zip_xy_scaler_snipe 1 2>, <&zip_temp_layer_custom 4 1000>;
    };
};
